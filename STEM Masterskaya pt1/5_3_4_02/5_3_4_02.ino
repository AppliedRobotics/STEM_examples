#include <Dynamixel2Arduino.h>  // подключение библиотеки Dynamixel

// Последовательный порт DXL для платы STEM с OpenCM 9.04. (Если использовать DXL порт 
// на самой плате OpenCM 9.04, то нужно использовать Serial1, и из-за кода в драйвере, 
// необходимо перед dxl.begin() вызвать Serial1.setDxlMode(true).)
#define DXL_SERIAL   Serial3
#define DEBUG_SERIAL Serial // последовательный порт, подключаемый к компьютеру

const uint8_t DXL_DIR_PIN = 22; // номер информационного пина сервоприводов (28 для OpenCM 9.04)
const float DXL_PROTOCOL_VERSION = 2.0; // протокол передачи данных от OpenCM9.04 к сервоприводам

Dynamixel2Arduino dxl(DXL_SERIAL, DXL_DIR_PIN); // инициализация указателя на команды из библиотеки Dynamixel

#define jointN 5 // инициализация константы, обозначающей количество сервоприводов (и, соответственно, элементов массива)
int pos = 0; // инициализация переменной для положения сервопривода
int i = 0; // инициализация переменной счетчика циклов
int buf[jointN+1]; // инициализация одномерного массива, размер его задается 5+1=6, так как в программировании нумерация элементов начинается с 0, но нулевой элемент мы использовать не будем, так как начнем с первого

void setup() {
  DEBUG_SERIAL.begin(57600); // установка скорости обмена данными по последовательному порту компьютера
  dxl.begin(1000000); // установка скорости обмена данными по последовательному порту манипулятора
  dxl.setPortProtocolVersion(DXL_PROTOCOL_VERSION);   // выбор протокола обмена данными
  for (i=1; i<=jointN; i++)  // цикл с изменением i от 1 до 5 с шагом 1
  {
      dxl.torqueOff(i); // отключаем крутящий момент, когда изменяем EEPROM область в сервоприводе
      dxl.setOperatingMode(i, OP_POSITION);  // установка режима работы сервопривода с номером i в качестве шарнира
  }
}

void loop() {
  
  for (i=1; i<=jointN; i++) // цикл с изменением i от 1 до 5 с шагом 1
  {
    pos = dxl.getPresentPosition(i); // получение текущей позиции сервопривода с номером i и запись в переменную pos
    buf[i] = pos; // запись переменной значения pos в i-тый элемент массива buf
    dxl.torqueOff(i);  // отключение блокировки сервопривода с номером i
  }

  DEBUG_SERIAL.print("{0, "); // вывод в монитор порта текста "{0, "
  for (i=1; i<=jointN; i++) // цикл с изменением i от 1 до 5 с шагом 1
  {
    DEBUG_SERIAL.print(buf[i]);// вывод в монитор порта значения ячейки массива с номером i
    DEBUG_SERIAL.print(", ");// вывод в монитор порта текста ", "
  }
  DEBUG_SERIAL.print("}, ");// вывод в монитор порта текста "}, "
  DEBUG_SERIAL.println(" ");// вывод в монитор порта текста " " и перенос курсора на следующую строку

  delay(1000);          // задержка, пауза в 1 секунду
  
}
