#include <Dynamixel2Arduino.h>  // подключение библиотеки Dynamixel

// Последовательный порт DXL для платы STEM с OpenCM 9.04. (Если использовать DXL порт 
// на самой плате OpenCM 9.04, то нужно использовать Serial1, и из-за кода в драйвере, 
// необходимо перед dxl.begin() вызвать Serial1.setDxlMode(true).)
#define DXL_SERIAL   Serial3
#define DEBUG_SERIAL Serial // последовательный порт, подключаемый к компьютеру

const uint8_t DXL_DIR_PIN = 22; // номер информационного пина сервоприводов (28 для OpenCM 9.04)
const float DXL_PROTOCOL_VERSION = 2.0; // протокол передачи данных от OpenCM9.04 к сервоприводам

Dynamixel2Arduino dxl(DXL_SERIAL, DXL_DIR_PIN); // инициализация указателя на команды из библиотеки Dynamixel

#define jointN 5 // инициализация константы, обозначающей количество сервоприводов (и ненулевых столбцов массива)
#define pages 7            // задание количества строк массива помимо начального положения
int i = 0; // задание переменной-счетчика i
int j = 0; // задание переменной-счетчика j

int buf[pages+1][jointN+1]={   // инициализация двумерного массива размером (7+1=8 на 5+1=6, 8 на 6), так как в программировании нумерация {0, 5,     4349, -5831, 1062, -6310, }, элементов начинается с 0. Но нулевой элемент строки мы использовать не будем, так как начнем с первого.

{0, 1038,  4349, -5831, 1062, -6310, },
{0, 1038,  4349, -5831, 1062, -6310, },
{0, 1038,  4000, -5622, 1062, -6310, },
{0, 1038,  3608, -5423, 1610, -6310, },
{0, 1038,  3608, -5423, 2440, -6310, },
{0, 1038,  3608, -5423, 2440, -5570, },
{0, 1038,  3608, -5423, 1062, -5570, },
};

void setup() {
  DEBUG_SERIAL.begin(57600); // установка скорости обмена данными по последовательному порту компьютера
  dxl.begin(1000000); // установка скорости обмена данными по последовательному порту манипулятора
  dxl.setPortProtocolVersion(DXL_PROTOCOL_VERSION);  // выбор протокола обмена данными
  
  for (i=1; i<=jointN; i++) {   // цикл с изменением счетчика цикла i от 1 до 5 с шагом 1 (для перебора всех 5 сервоприводов)
    dxl.torqueOff(i); // отключаем крутящий момент, когда изменяем EEPROM область в сервоприводе
    dxl.setOperatingMode(i, OP_POSITION); // установка режима работы сервопривода с номером i в качестве шарнира
    dxl.torqueOn(i); // включаем крутящий момент сервопривода для удержания целевого положения
  }
}

void loop() {

  for (i=0; i<=pages; i++)  // цикл с изменением i от 0 до 7 с шагом 1
  {
    for(j=1; j<=jointN; j++)  // цикл с изменением j от 1 до 5 с шагом 1
      {
        dxl.setGoalVelocity(j, 50);  // задание целевой скорости 50 сервоприводу с номером j
        dxl.setGoalPosition(j, buf[i][j]);  // задание целевого положения, получаемого из элемента ([i],[j]) сервоприводу с номером j
      }
    delay(3000);
  }
}
